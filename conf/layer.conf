## conf/layer.conf
```bitbake
# We have a conf and classes directory, add to BBPATH
BBPATH .= ":${LAYERDIR}"

# We have a packages directory, add to BBFILES
BBFILES += "${LAYERDIR}/recipes-*/*/*.bb \
            ${LAYERDIR}/recipes-*/*/*.bbappend"

BBFILE_COLLECTIONS += "bcm"
BBFILE_PATTERN_bcm := "^${LAYERDIR}/"
BBFILE_PRIORITY_bcm = "2"

LAYERDEPENDS_fsl-arm-extra = "core fsl-arm"
```

## conf/machine/ar6mxcs.conf
```bitbake
#@TYPE: Machine
#@NAME: BCM AR6MXCS
#@SOC: i.MX6Q

include conf/machine/include/imx-base.inc
include conf/machine/include/tune-cortexa9.inc

SOC_FAMILY = "mx6:mx6dl:mx6q"

KERNEL_DEVICETREE = "imx6dl-ar6mxcs.dtb"
KERNEL_IMAGETYPE = "uImage"

PREFERRED_PROVIDER_u-boot = "u-boot-ar6mxcs"
PREFERRED_PROVIDER_virtual/kernel = "linux-bcm"

# Use SPI NOR U-Boot by default
#IMAGE_BOOTLOADER ?= ""
UBOOT_MAKE_TARGET = ""
UBOOT_SUFFIX = "img"
UBOOT_ENTRYPOINT = "0x10800000"
UBOOT_CONFIG ??= "sd"
UBOOT_CONFIG[sd] = "ar6mxcs_config,sdcard"
UENV_FILENAME = "uEnv-${MACHINE}.txt"
BOOT_SCRIPTS = "${UENV_FILENAME}:uEnv.txt"
SPL_BINARY = "SPL"

#UBOOT_MACHINE = "ar6mxcs_config"

SERIAL_CONSOLE = "115200 ttymxc1"

# MACHINE_EXTRA_RRECOMMENDS += "linux-firmware-wl12xx"

# MACHINE_FEATURES += " pci wifi bluetooth"
```

## conf/machine/smarc.conf
```bitbake
#@TYPE: Machine
#@NAME: BCM SMARCQ
#@SOC: i.MX6Q

include conf/machine/include/imx-base.inc
include conf/machine/include/tune-cortexa9.inc

SOC_FAMILY = "mx6:mx6dl:mx6q"

KERNEL_DEVICETREE = "imx6q-rev-sa01-wm8326.dtb imx6q-rev-sa01-pfuze100.dtb"
KERNEL_IMAGETYPE = "zImage"

PREFERRED_PROVIDER_u-boot = "u-boot-smarc"
PREFERRED_PROVIDER_virtual/kernel ?= "linux-smarc"

# Use SPI NOR U-Boot by default
#IMAGE_BOOTLOADER ?= ""
#UBOOT_MAKE_TARGET = ""
#UBOOT_SUFFIX = "img"
#UBOOT_ENTRYPOINT = "0x10800000"
#UBOOT_CONFIG ??= "sd"
#UBOOT_CONFIG[sd] = "mx6qsmarc_config,sdcard"
#UENV_FILENAME = "uEnv-${MACHINE}.txt"
#BOOT_SCRIPTS = "${UENV_FILENAME}:uEnv.txt"
#SPL_BINARY = "SPL"

UBOOT_MACHINE = "mx6qsmarc_config"

SERIAL_CONSOLE = "115200 ttymxc1"

# MACHINE_EXTRA_RRECOMMENDS += "linux-firmware-wl12xx"

# MACHINE_FEATURES += " pci wifi bluetooth"
```
